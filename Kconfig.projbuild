## Kconfig.projbuild
```kconfig
menu "MicroTech Project Config"
    choice BOARD_TYPE
        prompt "Development Board"
        default BOARD_TYPE_WAVESHARE_ESP32_S3_TOUCH_AMOLED_1_8
        help
            Select the board to build for.
        config BOARD_TYPE_WAVESHARE_ESP32_S3_TOUCH_AMOLED_1_8
            bool "Waveshare ESP32-S3-Touch-AMOLED-1.8"
            depends on IDF_TARGET_ESP32S3
            select IO_EXPANDER_ENABLE_GPIO_API_WRAPPER
            select XPOWERS_ESP_IDF_NEW_API
        config BOARD_TYPE_WAVESHARE_ESP32_P4_WIFI6_TOUCH_LCD_3_5
            bool "Waveshare ESP32-P4-WIFI6-Touch-LCD-3.5"
            depends on IDF_TARGET_ESP32P4
            select XPOWERS_ESP_IDF_NEW_API
    endchoice

    config XPOWERS_ESP_IDF_NEW_API
        bool
endmenu
```
